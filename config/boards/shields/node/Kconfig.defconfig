## config/boards/shields/node/Kconfig.defconfig
```kconfig
if SHIELD_NODE_LEFT

config ZMK_KEYBOARD_NAME
    default "Node"

config ZMK_SPLIT_ROLE_CENTRAL
    default y

endif

if SHIELD_NODE_LEFT || SHIELD_NODE_RIGHT

config ZMK_SPLIT
    default y

endif
```

## config/boards/shields/node/Kconfig.shield
```kconfig
config SHIELD_NODE_LEFT
    def_bool $(shields_list_contains,node_left)

config SHIELD_NODE_RIGHT
    def_bool $(shields_list_contains,node_right)
```
